## config/boards/shields/swept/Kconfig.defconfig
```kconfig
# Copyright (c) 2022 Duccio Breschi
# SPDX-License-Identifier: MIT

if SHIELD_SWEPT_RIGHT

config ZMK_KEYBOARD_NAME
    default "Charybdis"

config ZMK_SPLIT_ROLE_CENTRAL
    default y

endif

if HIELD_SWEPT_LEFT || SHIELD_SWEPT_RIGHT

config ZMK_SPLIT
    default y
config ZMK_BLE
	default y

config I2C
	default y
      
config ZMK_POINTING
	default y
endif
```

## config/boards/shields/swept/Kconfig.shield
```kconfig
# Copyright (c) 2022 Duccio Breschi
# SPDX-License-Identifier: MIT

config SHIELD_CHARYBDIS_LEFT
    def_bool $(shields_list_contains,swept_left)

config SHIELD_CHARYBDIS_RIGHT
    def_bool $(shields_list_contains,swept_right)
```
